## Documentation/devicetree/bindings/pwm/pwm-xilinx.txt
```
Xilinx Axi PWM controller Device Tree Bindings
---------------------------------------------------------

Required properties:
- compatible        : Must be "xlnx,pwm-1.00"
- reg               : Physical base address and size of the Axi timer registers map.
- clock-frequency   : Frequency in ns of the AXI interface clock attached to the hardware device
- clocks            : The clock handle attached to the hardware device
- interrupt-parent  : Must be core interrupt controller.

Example:
    axi_timer_0: timer@42800000 {
        clock-frequency = <50000000>;
        #pwm-cells = <2>;
        clocks = <&clkc 15>;
        compatible = "xlnx,pwm-1.00";
        reg = <0x42800000 0x10000>;
        interrupt-parent = <&intc>;
    };
```
